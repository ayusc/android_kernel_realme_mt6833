## drivers/base/kernelFwUpdate/Kconfig
```kconfig
config OPLUS_FW_UPDATE
    help
        If unsure, say N.
        To compile this driver as a module, choose M here: the
```

## drivers/misc/oplus_misc_healthinfo/Kconfig
```kconfig
config OPLUS_MISC_HEALTHONFO
      default n
      help
        to your system.

	  If unsure, say N.
```

## drivers/nfc/oplus_nfc/Kconfig
```kconfig
config OPLUS_NFC
  default y
  help
	define this config to get chipset version from dts.
```

## drivers/soc/Kconfig
```kconfig
menu "SOC (System On Chip) specific Drivers"

source "drivers/soc/actions/Kconfig"
source "drivers/soc/amlogic/Kconfig"
source "drivers/soc/atmel/Kconfig"
source "drivers/soc/bcm/Kconfig"
source "drivers/soc/fsl/Kconfig"
source "drivers/soc/imx/Kconfig"
source "drivers/soc/mediatek/Kconfig"
source "drivers/soc/qcom/Kconfig"
source "drivers/soc/renesas/Kconfig"
source "drivers/soc/rockchip/Kconfig"
source "drivers/soc/samsung/Kconfig"
source "drivers/soc/sunxi/Kconfig"
source "drivers/soc/tegra/Kconfig"
source "drivers/soc/ti/Kconfig"
source "drivers/soc/ux500/Kconfig"
source "drivers/soc/versatile/Kconfig"
source "drivers/soc/xilinx/Kconfig"
source "drivers/soc/zte/Kconfig"

#ifdef OPLUS_FEATURE_LOWMEM_DBG
##endif /* OPLUS_FEATURE_LOWMEM_DBG */

#ifdef OPLUS_FEATURE_IOMONITOR
#endif /*OPLUS_FEATURE_IOMONITOR*/

#ifdef OPLUS_FEATURE_MEMLEAK_DETECT
#Add for svelte
#endif /* OPLUS_FEATURE_MEMLEAK_DETECT */

#ifdef OPLUS_BUG_STABILITY
#endif /* OPLUS_BUG_STABILITY */

#ifdef OPLUS_FEATURE_TP_BASIC
#Qicai.gu  12:00, 2020/06/03  devi info
##endif /* OPLUS_FEATURE_TP_BASIC */

#ifdef OPLUS_FEATURE_HEALTHINFO
#endif /* OPLUS_FEATURE_HEALTHINFO */

#ifdef OPLUS_FEATURE_MIDAS
#endif

#ifdef OPLUS_FEATURE_MIDAS
#endif

#Add for NandSwap

#ifdef OPLUS_FEATURE_HEALTHINFO
#endif /* OPLUS_FEATURE_HEALTHINFO */
endmenu
```

## drivers/soc/oplus/device_info/Kconfig
```kconfig
config OPLUS_DEVICE_IFNO
  help
    define this config to compile devinfo.c for device register
```
